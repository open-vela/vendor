/***************************************************************************
 *
 * Copyright 2015-2019 BES.
 * All rights reserved. All unpublished rights reserved.
 *
 * No part of this work may be used or reproduced in any form or by any
 * means, or stored in a database or retrieval system, without prior written
 * permission of BES.
 *
 * Use of this work is governed by a license granted by BES.
 * This work contains confidential and proprietary information of
 * BES. which is protected by copyright, trade secret,
 * trademark and other intellectual property rights.
 *
 ****************************************************************************/
/***************************************************************************
 *
 * Copyright 2015-2020 BES.
 * All rights reserved. All unpublished rights reserved.
 *
 * No part of this work may be used or reproduced in any form or by any
 * means, or stored in a database or retrieval system, without prior written
 * permission of BES.
 *
 * Use of this work is governed by a license granted by BES.
 * This work contains confidential and proprietary information of
 * BES. which is protected by copyright, trade secret,
 * trademark and other intellectual property rights.
 *
 ****************************************************************************/
/***************************************************************************
 *
 * Copyright 2015-2019 BES.
 * All rights reserved. All unpublished rights reserved.
 *
 * No part of this work may be used or reproduced in any form or by any
 * means, or stored in a database or retrieval system, without prior written
 * permission of BES.
 *
 * Use of this work is governed by a license granted by BES.
 * This work contains confidential and proprietary information of
 * BES. which is protected by copyright, trade secret,
 * trademark and other intellectual property rights.
 *
 ****************************************************************************/
/* total ram6 size is 0x30000 */
/* rename ram6 for network heap usage */
/* For linker scripts */
/* For module features */
/* Total 64M-byte space and let each flash ctrl owns 32M-byte space */
/* For boot struct version */
/* For ROM export functions */
/* Common RAM config checks (only check in lds file, the first compiled file during build) */
/* Definitions for lds only */
/* Always define FLASH_REGION_BASE for subsys lds */
/* config.h -- Autogenerated! Do not edit. */
/* Used to represent the values of tristate options */
/* General Definitions ***********************************/
/* Sanity Checks *****************************************/
/* If the end of RAM is not specified then it is assumed to be
 * the beginning of RAM plus the RAM size.
 */
/* If the end of FLASH is not specified then it is assumed to be
 * the beginning of FLASH plus the FLASH size.
 */
MEMORY
{
    BOOT (rwx) : ORIGIN = 0x00000000, LENGTH = (24 * 4)
    FLASH (rx) : ORIGIN = (0x2C000000), LENGTH = (0x1000000 - ((0x2C000000) - 0x2C000000))
    RAM (rwx) : ORIGIN = 0x50000000, LENGTH = 0x80000-0 - 0
    L_TTB (rw) : ORIGIN = 0x50000000 + 0x80000-0 - 0, LENGTH = 0
    PSRAM (rwx) : ORIGIN = (0x34000000 + 0x800000-0), LENGTH = 0
    PSRAMUHS (rwx) : ORIGIN = ((0x38000000)), LENGTH = 0x2000000-0-0-0x100000-0
    PSRAMUHS_NC (rx) : ORIGIN = (0x38000000 + 0x2000000-0x100000-0), LENGTH = (0x100000)
}
ENTRY(vector_reset)
SECTIONS
{
    .boot_loader :
    {
        . = ALIGN(0x1000);
        KEEP(*(.vectors))
        KEEP(*(.start))
        *:arm*_head.o(.text* .rodata*)
        *:bes_start.o(.text* .rodata*)
        *:bes_boot_loader.o(.text* .rodata*)
        *:bes_lzma_dec_code.o(.text* .rodata*)
        *:lzma_decode.o(.text* .rodata*)
        *:bin/lib_stackchk.o(.text* .rodata*)
        *:bin/arch_mem*.o(.text* .rodata*)
        *:bin/arch_str.o(.text* .rodata*)
        *:lib_stackchk.o(.text* .rodata*)
        *:stack_protector.o(.text* .rodata*)
        *:arch_mem*.o(.text* .rodata*)
        *:arch_str.o(.text* .rodata*)
        *:a7_dsp_os.o(.text* .rodata*)
        *:hal_timer.o(.text* .rodata*)
        *:hal_sysfreq.o(.text* .rodata*)
        *:hal_*cmu*(.text* .rodata*)
        *:system_ARMCA.o(.text* .rodata*)
        *:rtos_lib.o(.text* .rodata*)
        *libarch.a:(.text* .rodata*)
        *libsched.a:(.text* .rodata*)
        . = ALIGN(0x800);
        KEEP(*(.exc_vector_table._vector_table_section))
        . = ALIGN(0x1000);
    } > PSRAMUHS
    .boot_loader_data :
    {
        __bl_data_start__ = .;
        . = ALIGN(0x1000);
        *:arm*_head.o(.data*)
        *:bes_start.o(.data*)
        *:bes_boot_loader.o(.data*)
        *:bes_lzma_dec_code.o(.data*)
        *:lzma_decode.o(.data*)
        *:bin/lib_stackchk.o(.data*)
        *:bin/arch_mem*.o(.data*)
        *:bin/arch_str*.o(.data*)
        *:lib_stackchk.o(.data*)
        *:stack_protector.o(.data*)
        *:arch_mem*.o(.data*)
        *:arch_str.o(.data*)
        *:a7_dsp_os.o(.data*)
        *:hal_timer.o(.data*)
        *:hal_sysfreq.o(.data*)
        *:hal_*cmu*(.data*)
        *:system_ARMCA.o(.data*)
        *:rtos_lib.o(.data*)
        *libarch.a:(.data*)
        *libsched.a:(.data*)
    } > PSRAMUHS
    .boot_loader_bss :
    {
        __bl_bss_start__ = .;
        _sbss = .;
        *:arm*_head.o(.bss*)
        *:bes_start.o(.bss*)
        *:bes_boot_loader.o(.bss*)
        *:bes_lzma_dec_code.o(.bss*)
        *:lzma_decode.o(.bss*)
        *:bin/lib_stackchk.o(.bss*)
        *:bin/arch_mem*.o(.bss*)
        *:bin/arch_str*.o(.bss*)
        *:lib_stackchk.o(.bss*)
        *:stack_protector.o(.bss*)
        *:arch_mem*.o(.bss*)
        *:arch_str.o(.bss*)
        *:a7_dsp_os.o(.bss*)
        *:hal_timer.o(.bss*)
        *:hal_sysfreq.o(.bss*)
        *:hal_*cmu*(.bss*)
        *:system_ARMCA.o(.bss*)
        *:rtos_lib.o(.bss*)
        *libarch.a:(.bss*)
        *libsched.a:(.bss*)
        . = ALIGN(64);
        _ebss = .;
        *(.initstack)
        _e_initstack = .;
        g_cpu0_idlestack = ABSOLUTE(.);
        . += 4096; /* Idle task stack*/
        . = ALIGN(0x1000);
        __bl_data_end__ = .;
    } > PSRAMUHS
    .ARM.extab :
    {
        *(.ARM.extab* .gnu.linkonce.armextab.*)
    } > PSRAMUHS
    __exidx_start = .;
    .ARM.exidx :
    {
        *(.ARM.exidx* .gnu.linkonce.armexidx.*)
    } > PSRAMUHS
    __exidx_end = .;
    .sram_text :
    {
        __sram_text_data_start__ = .;
        __sram_text_start__ = .;
        /* memcpy.o or libc_nano.a(lib_a-memcpy.o/lib_a-memcpy-stub.o) */
        *:memcpy.o(.text*)
        *:lib_a-memcpy*.o(.text*)
        *:libc_rom.o(.text*)
        /* memset.o or libc_nano.a(lib_a-memset.o) */
        *:memset.o(.text*)
        *:lib_a-memset*.o(.text*)
        . = ALIGN(4);
        __kernel_init_level_0 = ABSOLUTE(.);
        KEEP(*( SORT (.rodata.init.kernel.0.*)));
        __kernel_init_level_1 = ABSOLUTE(.);
        KEEP(*( SORT (.rodata.init.kernel.1.*)));
        __kernel_init_level_2 = ABSOLUTE(.);
        KEEP(*( SORT (.rodata.init.kernel.2.*)));
        __kernel_init_level_3 = ABSOLUTE(.);
        KEEP(*( SORT (.rodata.init.kernel.3.*)));
        __kernel_init_level_4 = ABSOLUTE(.);
        KEEP(*( SORT (.rodata.init.kernel.4.*)));
        __kernel_init_level_5 = ABSOLUTE(.);
        KEEP(*( SORT (.rodata.init.kernel.5.*)));
        __kernel_init_level_6 = ABSOLUTE(.);
        KEEP(*( SORT (.rodata.init.kernel.6.*)));
        __kernel_init_level_7 = ABSOLUTE(.);
        KEEP(*( SORT (.rodata.init.kernel.7.*)));
        __kernel_init_level_8 = ABSOLUTE(.);
        KEEP(*( SORT (.rodata.init.kernel.8.*)));
        __kernel_init_level_9 = ABSOLUTE(.);
        KEEP(*( SORT (.rodata.init.kernel.9.*)));
        __kernel_init_level_10 = ABSOLUTE(.);
        _hdf_drivers_start = .;
        KEEP(*(.hdf.driver));
        _hdf_drivers_end = .;
        KEEP(*( SORT (.liteos.table.*)));
        *:hal_timer.o(.text* .rodata*)
        *:hal_sysfreq.o(.text* .rodata*)
        *:hal_cmu_best2003.o(.text* .rodata*)
        . = ALIGN(0x1000);
        __sram_text_end__ = .;
    } > PSRAMUHS AT > PSRAMUHS
 __sram_text_start_load__ = LOADADDR(.sram_text);
 __sram_text_end_load__ = LOADADDR(.sram_text) + SIZEOF(.sram_text);
    .sram_data :
    {
        __sram_data_start__ = .;
        *(.boot_data*)
        *:hal_timer.o(.data*)
        *:hal_sysfreq.o(.data*)
        *:hal_cmu_best2003.o(.data*)
        __sram_data_end__ = .;
    } > PSRAMUHS AT > PSRAMUHS
 __sram_data_start_load__ = LOADADDR(.sram_data);
 __sram_data_end_load__ = LOADADDR(.sram_data) + SIZEOF(.sram_data);
 . = __sram_data_end_load__;
    _mmu_text_start = ORIGIN(PSRAMUHS);
    _stext = _mmu_text_start;
    _etext = _mmu_text_end;
    /*
    _mmu_text_end = __rodata_end;
    */
    _mmu_text_len = _mmu_text_end - _mmu_text_start;
    .copy.table (.) :
    {
        . = ALIGN(4);
        __copy_table_start__ = .;
        LONG (__etext)
        LONG (__data_start__)
        LONG (__data_end__ - __data_start__)
        __copy_table_end__ = .;
    } > PSRAMUHS
    .zero.table :
    {
        . = ALIGN(4);
        __zero_table_start__ = .;
        LONG (__bss_start__)
        LONG (__bss_end__ - __bss_start__)
        __zero_table_end__ = .;
    } > PSRAMUHS
    __etext = .;
    .tdata : {
        __tdata_start = .;
        *(.tdata)
        *(.tdata.*)
        *(.gnu.linkonce.td.*)
        __tdata_end = .;
    } > PSRAMUHS
    .sram_bss (NOLOAD) : AT (ADDR(.sram_bss))
    {
        . = ALIGN(4);
        __sram_bss_start__ = .;
        *(.boot_bss*)
        *(.sram_bss*)
        . = ALIGN(4);
        __sram_bss_end__ = .;
    } > PSRAMUHS
    __ram_end = .;
    .sbss (NOLOAD) : {
        . = ALIGN(4);
        __sbss_start = .;
        *(.sbss)
        *(.sbss.*)
        *(.gnu.linkonce.sb.*)
        . = ALIGN(4);
        __sbss_end = .;
    } > PSRAMUHS
    .tbss (NOLOAD) : {
        . = ALIGN(4);
        __tbss_start = .;
        *(.tbss)
        *(.tbss.*)
        *(.gnu.linkonce.tb.*)
        . = ALIGN(4);
        __tbss_end = .;
    } > PSRAMUHS
    .heap (NOLOAD) :
    {
        . = ALIGN(8);
        Image$$HEAP$$ZI$$Base = .;
        . += 0x1000;
        Image$$HEAP$$ZI$$Limit = .;
        __HeapLimit = .;
    } > PSRAMUHS
    __free_exec_region = ORIGIN(PSRAMUHS) + LENGTH(PSRAMUHS) - .;
    __psramuhs_text_data_end_load__ = LOADADDR(.data) + SIZEOF(.data);
    .psramuhs_bss (.) (NOLOAD) : AT (ADDR(.psramuhs_bss))
    {
        . = ALIGN(4);
        __psramuhs_bss_start__ = .;
        *(.psramuhs_bss*)
        . = ALIGN(4);
        __psramuhs_bss_end__ = .;
    } > PSRAMUHS
 .build_info (.) :
 {
  KEEP(*(.build_info))
  . = ALIGN(4);
    } > PSRAMUHS
 __boot_struct_build_info = ADDR(.build_info);
    __exec_load_end__ = LOADADDR(.build_info) + SIZEOF(.build_info);
    /* The following section MUST be the last loaded section */
    .code_start_addr (.):
    {
        LONG(ADDR(.boot_loader));
    } > PSRAMUHS
    .text (.) :
    {
        . = ALIGN(0x1000);
        __text_start = .;
        . += 16;
        *:_aeabi_*.o(.text*)
        *:arm_*.o(.text* .rodata*)
        *(SVC_TABLE)
        *(.text*)
        *(.flash_text*)
        KEEP(*(.init))
        KEEP(*(.fini))
        . = ALIGN(16);
        _sinit = .;
        /* preinit data */
        PROVIDE (__preinit_array_start = .);
        KEEP(*(.preinit_array))
        PROVIDE (__preinit_array_end = .);
        /* init data */
        PROVIDE(__ctors_start__ = .);
        PROVIDE (__init_array_start = .);
        KEEP(*(SORT(.init_array.*)))
        KEEP(*(.init_array))
        PROVIDE (__init_array_end = .);
        PROVIDE(__ctors_end__ = .);
        /* .ctors */
        *crtbegin.o(.ctors)
        *crtbegin?.o(.ctors)
        *(EXCLUDE_FILE(*crtend?.o *crtend.o) .ctors)
        *(SORT(.ctors.*))
        *(.ctors)
        _einit = .;
        . = ALIGN(4);
        /* finit data */
        PROVIDE (__fini_array_start = .);
        KEEP(*(SORT(.fini_array.*)))
        KEEP(*(.fini_array))
        PROVIDE (__fini_array_end = .);
        /* .dtors */
        *crtbegin.o(.dtors)
        *crtbegin?.o(.dtors)
        *(EXCLUDE_FILE(*crtend?.o *crtend.o) .dtors)
        *(SORT(.dtors.*))
        *(.dtors)
        . = ALIGN(4);
        __rodata_start = .;
        __exc_table_start = .;
        KEEP(*(__exc_table))
        __exc_table_end = .;
        *(.rodata*)
        *(.boot_rodata*)
        __rodata_end = .;
        . = ALIGN(4);
        KEEP(*(.eh_frame*))
        *(.note.gnu.build-id)
        /*. = ALIGN(4);*/
        . = ALIGN(0x1000);
        _mmu_text_end = .;
        _etext = .;
    } > PSRAMUHS
    __text_end = .;
    .data :
    {
        . = ALIGN(4);
        Image$$RW_DATA$$Base = .;
        __data_start__ = .;
        _sdata = .;
        *(.data*)
        *(.psram_data*)
        Image$$RW_DATA$$Limit = .;
        . = ALIGN(4);
        /* All data end */
        *(*.got*)
        . = ALIGN(4);
        __data_end__ = .;
        _edata = .;
    } > PSRAMUHS
    .sync_flags (ORIGIN(PSRAMUHS_NC)) (NOLOAD) :
    {
        __sync_flags_start = .;
        *(.sync_flags*)
        __sync_flags_end = .;
    } > PSRAMUHS_NC
    .bss (NOLOAD) :
    {
        . = ALIGN(0x400);
        __bss_start = .;
        Image$$ZI_DATA$$Base = .;
        __bss_start__ = .;
        *(.bss*)
        *(.psram_bss*)
        *(COMMON)
        . = ALIGN(4);
        __bss_end__ = .;
        Image$$ZI_DATA$$Limit = .;
        __end__ = .;
        end = __end__;
        __bss_end = .;
    } > PSRAMUHS
    .os_heap (NOLOAD) :
    {
    } > PSRAMUHS
    .noinit :
    {
        _snoinit = ABSOLUTE(.);
        *(.noinit*)
        KEEP(*(.reboot_custom_param*))
        _enoinit = ABSOLUTE(.);
        . = ALIGN(8);
        . += 4096; /* Idle task stack*/
        . = ALIGN(8);
    } > PSRAMUHS
    __free_ram_uncache = (ORIGIN(PSRAMUHS_NC) + LENGTH(PSRAMUHS_NC) - 0x20000);
    ASSERT(__sync_flags_end <= __free_ram_uncache, "region PSRAM/SRAM NC overflowed")
    _sdata = __bl_data_start__;
    _szdata = __bl_data_end__ - _sdata;
    _sztext = __bl_data_start__ - _stext;
    _srodata = _stext;
    _szrodata = 0;
    _nuttx_heap_start = .;
    _nuttx_heap_end = ORIGIN(PSRAMUHS) + LENGTH(PSRAMUHS) - 0x10000;
    .ttb_l2 (NOLOAD) :
    {
        Image$$TTB$$ZI$$Base = .;
        *(.ttb_l2)
    } > L_TTB
    .ttb_l1 (NOLOAD) :
    {
        *(.ttb_l1)
        Image$$TTB$$ZI$$Limit = .;
    } > L_TTB
    __free_ttb = ORIGIN(L_TTB) + LENGTH(L_TTB) - .;
    .framebuffer (ORIGIN(RAM)) (NOLOAD) :
    {
        *(.framebuffer*)
    } > RAM
}
